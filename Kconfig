## Kconfig
```kconfig
menu "Ninux Voltage Meter Configuration"

    config R1  
        int "R1 (reference) resistence value"
	default 10 
        help
            int, containing R1 value

    config R2  
        int "R2 resistence value"
	default 33
        help
            int, containing R2 value

    config TRANSISTOR_GPIO  
        int "transistor gpio pin number"
	default 33
        help
            int, tranistor gpio pin number 
endmenu
```
